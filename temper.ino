#include "DHT.h"
#include <Wire.h>
#include <SPI.h>
#include<Adafruit_GFX.h>
#include<Adafruit_SSD1306.h>
#define OLED_RESET -1
Adafruit_SSD1306 OLED(OLED_RESET);
#define DHTTYPE DHT22
#define DHTPIN D4
DHT dht (DHTPIN,DHTTYPE, 15);
#include <Adafruit_NeoPixel.h>
#define NUMSLEDs 2
#define PINSLEDs 10
Adafruit_NeoPixel SLEDs= Adafruit_NeoPixel (NUMSLEDs,PINSLEDs,NEO_RGB+NEO_KHZ800);
const int buzzer = D8; 
#define ledPin1 D0    
#define ledPin2 D5
#define ledPin3 D6
#define sw1 D3 
#define sw2 D7  
#include <Wire.h>
#include <SPI.h>
#include <Adafruit_GFX.h>
#include <Adafruit_SSD1306.h>
#define OLED_RESET -1
int st_sw1 = 0;             
int st_1 = 0;
int last_st_sw1 = 1;
int st_sw2 = 0;             
int st_2 = 0;
int last_st_sw2 = 1;
#define sw3 D9
int st_sw3 = 0;             
int st_3 = 0;
int last_st_sw3 = 1;
const unsigned char Logo_bmp [] = {
0x00, 0x00, 0x00, 0x00, 0x00, 0x00, 0x00, 0x00, 0x00, 0x00, 0x00, 0x00, 0x00, 0x00, 0x00, 0x00,
0x00, 0x00, 0x00, 0x00, 0x00, 0x00, 0x00, 0x00, 0x00, 0x00, 0x00, 0x00, 0x00, 0x00, 0x00, 0x00,
0x00, 0x00, 0x00, 0x00, 0x00, 0x00, 0x00, 0x00, 0x00, 0x00, 0x00, 0x00, 0x00, 0x00, 0x00, 0x00,
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0x00, 0x00, 0x00, 0x00, 0x00, 0x00, 0x00, 0x00, 0x00, 0x00, 0x00, 0x00, 0x00, 0x00, 0x00, 0x00
};
const unsigned char Logo2_bmp [] = {
0x00, 0x00, 0x00, 0x00, 0x00, 0x00, 0x00, 0x00, 0x00, 0x00, 0x00, 0x00, 0x00, 0x00, 0x00, 0x00,
0x00, 0x00, 0x00, 0x7F, 0xFF, 0x80, 0x00, 0x00, 0x00, 0x00, 0x01, 0xFF, 0xFE, 0x00, 0x00, 0x00,
0x00, 0x00, 0x1F, 0xFF, 0xFF, 0xFC, 0x00, 0x00, 0x00, 0x00, 0x3F, 0xFF, 0xFF, 0xF8, 0x00, 0x00,
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0x00, 0x00, 0x00, 0x00, 0x00, 0x00, 0x00, 0x00, 0x00, 0x00, 0x00, 0x00, 0x00, 0x00, 0x00, 0x00
};
const unsigned char Logo3_bmp [] = {
0x00, 0x00, 0x00, 0x00, 0x00, 0x00, 0x00, 0x07, 0xE0, 0x00, 0x00, 0x00, 0x00, 0x00, 0x00, 0x00,
0x00, 0x00, 0x00, 0x00, 0x00, 0x00, 0x7F, 0x80, 0x0F, 0xFC, 0x00, 0x00, 0x00, 0x00, 0x00, 0x00,
0x00, 0x00, 0x00, 0x00, 0x00, 0x3E, 0x00, 0x00, 0x00, 0x3D, 0xFC, 0x00, 0x00, 0x00, 0x00, 0x00,
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0x00, 0x00, 0x00, 0x00, 0x00, 0x00, 0x00, 0x07, 0x80, 0x00, 0x00, 0x00, 0x00, 0x00, 0x00, 0x00
};
void setup() {
Serial.begin(115200);
OLED.begin(SSD1306_SWITCHCAPVCC, 0x3c);
pinMode (PINSLEDs,OUTPUT);
SLEDs.begin();
SLEDs.show();
 pinMode(buzzer, OUTPUT);
  pinMode(ledPin1, OUTPUT); 
  pinMode(ledPin2, OUTPUT); 
  pinMode(ledPin3,OUTPUT);
pinMode(sw1, INPUT);
tone(D8, OUTPUT);
pinMode(sw2, INPUT);
pinMode(sw3,INPUT);
}

void loop() {
  float h = dht.readHumidity();
float t = dht.readTemperature();
float f = dht.readTemperature(true);
Serial.println(h);
if (isnan(h) || isnan(t) || isnan(f) )
{
  Serial.println("Failed to read from DHT sensor!");
  
}
else 
{
  OLED.clearDisplay();
  OLED.setTextColor(WHITE);
  OLED.setCursor(0,0);
  OLED.setTextSize(1);
  OLED.println(h);
  OLED.setCursor(0,30);
  OLED.print(t);
  OLED.display();
}
if(t>30)
{
  SLEDs.setPixelColor(0,SLEDs.Color(1,255,1));
 SLEDs.show();
  tone(buzzer, 100);
  digitalWrite(ledPin2, 0);
  digitalWrite(ledPin1, 1);
digitalWrite(ledPin3,0);
}
else
{
SLEDs.setPixelColor(0,SLEDs.Color(0,0,255));
SLEDs.show();
 tone(buzzer, 50);
 digitalWrite(ledPin2, 1);
 digitalWrite(ledPin1, 0);
 digitalWrite(ledPin3, 0);
 }
    st_sw1 = digitalRead(sw1);                
  if ((st_sw1 == 0) && (last_st_sw1 == 1))  
  {
    st_1 = ~st_1;                           
    OLED.clearDisplay();
  OLED.drawBitmap(20,0,Logo_bmp,128,64,1);
  OLED.display();
    delay(1000);
  }
  last_st_sw1 = st_sw1;  


  if (t<28)                 
{ 
 SLEDs.setPixelColor(0,SLEDs.Color(255,0,0));
SLEDs.show();
tone(buzzer, 0);
 digitalWrite(ledPin2, 0);
 digitalWrite(ledPin1, 0);
 digitalWrite(ledPin3,1);
}
    st_sw2 = digitalRead(sw2);                
  if ((st_sw2 == 0) && (last_st_sw2 == 1))  
  {
    st_2 = ~st_2;                           
    OLED.clearDisplay();
  OLED.drawBitmap(20,0,Logo2_bmp,128,64,1);
  OLED.display();
    delay(1000);
  }
  last_st_sw2 = st_sw2; 
st_sw3 = digitalRead(sw3);                
  if ((st_sw3 == 0) && (last_st_sw3 == 1))  
  {
    st_3 = ~st_3;                           
    OLED.clearDisplay();
  OLED.drawBitmap(20,0,Logo3_bmp,128,64,1);
  OLED.display();
    delay(1000);
  }
  last_st_sw3 = st_sw3; 

  
}





 
 



  
